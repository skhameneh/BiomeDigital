## Firmware/sdkconfig.defaults
```kconfig
CONFIG_ESP32_XTAL_FREQ_40=n
CONFIG_ESP32_XTAL_FREQ_26=y
CONFIG_ESP32_XTAL_FREQ_40=n
CONFIG_ESP32_XTAL_FREQ=

CONFIG_BT_ENABLED=y
CONFIG_BTDM_CTRL_MODE_BLE_ONLY=y
CONFIG_BTDM_CTRL_MODE_BR_EDR_ONLY=n
CONFIG_BTDM_CTRL_MODE_BTDM=n
CONFIG_COMPILER_CXX_EXCEPTIONS=y
```
